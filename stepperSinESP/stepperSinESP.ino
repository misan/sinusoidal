// sample code of a Sinusoidal S-curve code for driving a stepper motor
// it runs on a ESP32, Arduino UNO is ok for low speed only as calculations take much longer
// this is just a proof of concept
// by misan, April 2018


const double espTime[] = {0,0.8339606223319053,0.9946382076625534,1.102915144710818,1.187087301995585,1.256985726887124,1.317307868080828,1.370698791711928,1.418808837054632,1.462743256670634,1.503281772696069,1.540996854329344,1.576322314637914,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6.279756365744141,6.28289452179612};

// using CNCshield
#define STEPX T5
#define DIRX  15
#define ENABLE T2
#define STEPY T4
#define DIRY  16
#define STEPZ T6
#define DIRZ  17
#define SERVO T7
#define STEPS_MM 

double accel=80e3;
double speed=10e3;

int MAX=1000;
const float PI2=PI*PI;
float at=PI*PI/MAX; // 9.867

// linear interpolation function
float solve(float t) { // will return the interpolated time (0..2*PI) that corresponds to a given distance (0 .. PI^2) according to espTime table
 if(t>=PI2) return espTime[MAX-1]; 
 int n=(t/at); 
 float dt=t-n*at;
 if(dt==0) return espTime[n];
 return (espTime[n+1]-espTime[n])*dt/at+espTime[n];
}

void setup() {
  pinMode(ENABLE, OUTPUT); // enable
  pinMode(STEPY, OUTPUT); // stepY
  pinMode(DIRY, OUTPUT); // dirY
  digitalWrite(ENABLE, LOW);
  Serial.begin(115200);
}

int i=0;
int M=5000;  // number of steps at cruising speed
int N=2000;  // number of accel/decel steps
float kt=0.01*10e6; //time adjust constant, accel time = 2*PI*kt = 0.628 seconds
float d=0; // distance traveled 
float t=0; // time elapsed
float last; // keep delay value for cruising speed

float tt;
void loop() {
  
  Serial.println("Accel");
  for(int i=1; i<N; i++) {
    d=PI2*i/N; 
    tt=solve(d)*kt;
    last=tt-t;
    //Serial.println(tt-t); 
    delayMicroseconds(last); // delay is the time difference between values
    digitalWrite(STEPY, HIGH);
    delayMicroseconds(2);
    digitalWrite(STEPY, LOW);
    t=tt;  
  } 
  Serial.println("Cruise");
  for(int i=0; i<M; i++) {
    delayMicroseconds(last); // delay is the time difference between values
    digitalWrite(STEPY, HIGH);
    delayMicroseconds(2);
    digitalWrite(STEPY, LOW);
  }
  Serial.println("Decel");
  for(int i=N-1; i>0; i--) {
    d=PI2*i/N; 
    tt=solve(d)*kt;
    delayMicroseconds(t-tt); // delay is the time difference between values
    digitalWrite(STEPY, HIGH);
    delayMicroseconds(2);
    digitalWrite(STEPY, LOW);
    t=tt;  
  }
  t=0;delay(2000);

}
