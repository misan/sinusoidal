// test four different patterns for stepper acceleration
// test program for DOIT ESPDUINO + CNCShield 3
// remove resistor R1 from CNCshield !!!
// May 2018 
// by misan


PROGMEM const int  speed0[]={0,3847,1646,1263,1064,938,848,779,725,681,644,613,585,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62,62};
PROGMEM const int  speed1[]={0,16562,3206,2164,1683,1397,1206,1067,962,878,810,754,706,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62,62};
PROGMEM const int  speed2[]={0,14018,2721,1839,1432,1191,1029,912,823,753,695,648,607,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75,75};
PROGMEM const int  speed3[]={0,8538,2272,1601,1281,1085,952,855,779,719,669,628,593,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77,77};

int i=0;

float scale;

#define STEPX 26
#define DIRX  16
#define ENABLE 12
#define STEPY 25
#define DIRY  27
#define STEPZ 25
#define DIRZ  14
#define SERVO 23
#define ledPin 2

const int* espTime=speed0;


int incr=1;

void setup()
{
  pinMode(ENABLE, OUTPUT); // enable
  pinMode(STEPY, OUTPUT); // stepY
  pinMode(DIRY, OUTPUT); // dirY
  digitalWrite(ENABLE, LOW);
  
  Serial.begin(115200);
}

long t;
void loop()
{ for(int speed=5; speed<18; speed++) {
  t=millis();
  motion((3200),(20000),speed*160); 
   Serial.print(" T="); Serial.println(millis()-t);
  delay(2000); 
  }
}





float t1, step_rate;
int e1, N;

void motion(int L, float a, float vm) { // move L steps, with a accel and vm as max speed for trapezoidal-like motion
  t1=vm/a;    // acceleration tim
  e1=t1*vm/2; // number of steps for acceleration
  if(L<2*e1) {e1=L/2; t1=sqrt(2*a*e1)/a; }  // case of triangular motion 
  N=L-2*e1;     // remaining steps for coasting at vm speed
  //t1*=10;  // pre-scale for table operation
  Serial.print("t1="); Serial.print(t1); Serial.print(" e1="); Serial.print(e1); Serial.print(" N="); Serial.print(N);
  accel(t1,e1);
  coast(N);
  decel(t1,e1); 
}

void accel(float t1, int e1) {
// adapt the acceleration phase to last t1 seconds
  for(i=0; i<e1; i++) {
    delayMicroseconds((step_rate = whatDelay(i,e1)*t1*1000/e1)); 
    digitalWrite(STEPY, HIGH);
    digitalWrite(STEPY, LOW);
  }
}

int whatDelay(int i, int e1) { // takes the number of actual step and total accel steps and returns the time from 0 to 2*PI
  return pgm_read_word_near(speed3 + (i*1000/e1)); 
}

void coast(int N) {
  for(i=0; i<N; i++) {
    delayMicroseconds(step_rate);
    digitalWrite(STEPY, HIGH);
    digitalWrite(STEPY, LOW);
  }
}


void decel(float t1, int e1) {
// adapt the acceleration phase to last t1 seconds
  for(i=e1; i>0; i--) {
    delayMicroseconds(whatDelay(i,e1)*t1*1000/e1);
    digitalWrite(STEPY, HIGH);
    digitalWrite(STEPY, LOW);
  }
}
